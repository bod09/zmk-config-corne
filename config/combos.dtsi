// ╭───┬───┬───┬───┬───┬───╮   ╭───┬───┬───┬───┬───┬───╮
// | 0 | 1 | 2 | 3 | 4 | 5 |   |   |   |   |   |   |   |
// ├───┼───┼───┼───┼───┤───┤   ├───┼───┼───┼───┼───┤───┤
// |   |   |   |   |   |   |   |   |   |   |   |   |   |
// ├───┼───┼───┼───┼───┤───┤   ├───┼───┼───┼───┼───┤───┤
// |   |   |   |   |   |   |   |   |   |   |   |   |   |
// ╰───┴───┴───┼───┼───┤───┤   ├───┼───┼───┼───┴───┴───╯
//             |   |   |   |   |   |   |   |
//             ╰───┴───┴───╯   ╰───┴───┴───╯

compatible = "zmk,combos";

combo_esc {
        key-positions = <0 1>;
        bindings = <&kp ESC>;
};

combo_test {
        key-positions = <0 6>;
        bindings = <&kp ESC>;
};